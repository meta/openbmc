/*
 * Copyright 2026-present Facebook. All Rights Reserved.
 */

&sdrammc {
	ecc-enable;
};

/* Host does not use eDAF; only BMC drives the SPIx controllers */
&edaf_bridge0 {
	status = "disabled";
};

&edaf_bridge1 {
	status = "disabled";
};
