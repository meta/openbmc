## meta-facebook/meta-churchillmono/conf/layer.conf
```bitbake
# We have a conf and classes directory, add to BBPATH
BBPATH .= ":${LAYERDIR}"

FB_PROPRIETARY_RECIPES:fb-proprietary-recipes = " \
    ${LAYERDIR}/../../proprietary/cisco/meta-cisco/recipes-*/*/*.bb \
    ${LAYERDIR}/../../proprietary/cisco/meta-cisco/recipes-*/*/*.bbappend \
    ${LAYERDIR}/../../proprietary/cisco/meta-churchillmono/recipes-*/*/*.bb \
    ${LAYERDIR}/../../proprietary/cisco/meta-churchillmono/recipes-*/*/*.bbappend \
    "

# We have recipes-* directories, add to BBFILES
BBFILES += "\
    ${LAYERDIR}/recipes-*/*/*.bb \
    ${LAYERDIR}/recipes-*/*/*.bbappend \
    ${FB_PROPRIETARY_RECIPES} \
    "

BBFILE_COLLECTIONS += "churchillmono"
BBFILE_PATTERN_churchillmono = "^${LAYERDIR}/"
BBFILE_PRIORITY_churchillmono = "20"

LAYERSERIES_COMPAT_churchillmono = "blacksail wrynose whinlatter walnascar styhead scarthgap nanbield kirkstone dunfell"

DISTRO_FEATURES:append = " systemd"
VIRTUAL-RUNTIME_init_manager = "systemd"

LICENSE_PATH:fb-proprietary-recipes += "${LAYERDIR}/../../proprietary/cisco/meta-cisco/custom-licenses"
COMPANY_COMMON_LICENSES:fb-proprietary-recipes := '${@os.path.normpath("${LAYERDIR}/../../proprietary/cisco/meta-cisco/custom-licenses")}'
```

## meta-facebook/meta-elbert/conf/layer.conf
```bitbake
# We have a conf and classes directory, add to BBPATH
BBPATH .= ":${LAYERDIR}"

# We have recipes-* directories, add to BBFILES
BBFILES += "${LAYERDIR}/recipes-*/*/*.bb \
	          ${LAYERDIR}/recipes-*/*/*.bbappend \
            ${LAYERDIR}/facebook/recipes-*/*/*.bb \
	          ${LAYERDIR}/facebook/recipes-*/*/*.bbappend"

INIT_MANAGER = "systemd"
DISTRO_FEATURES:append = " systemd usrmerge"
VIRTUAL-RUNTIME_init_manager = "systemd"
DISTRO_FEATURES_OPTED_OUT += "sysvinit"

BBFILE_COLLECTIONS += "elbert"
BBFILE_PATTERN_elbert = "^${LAYERDIR}/"
BBFILE_PRIORITY_elbert = "20"

LAYERSERIES_COMPAT_elbert = "blacksail wrynose whinlatter walnascar styhead scarthgap nanbield kirkstone dunfell"
```
