## meta-facebook/meta-yosemite5/meta-yosemite5a7/conf/machine/yosemite5a7-upstream-overrides.conf
```bitbake
YV5A7_ASSUMED_PROVIDERS = ""
YV5A7_IMAGE_FSTYPES_REMOVE = ""

PREFERRED_PROVIDER_virtual/kernel = "linux-aspeed"

KERNEL_DEVICETREE = "aspeed/${KMACHINE}-bmc-facebook-${MACHINE}.dtb"

PREFERRED_PROVIDER_virtual/bootmcu = "zephyr-aspeed-bootmcu"

ZEPHYR_TOOLCHAIN_VARIANT = "zephyr"
PREFERRED_VERSION_zephyr-sdk-native = "0.16.9"
PREFERRED_VERSION_zephyr-kernel ??= "3.7.0"
```
